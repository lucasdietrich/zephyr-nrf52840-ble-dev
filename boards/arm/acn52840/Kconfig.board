## boards/arm/acn52840/Kconfig.board
```kconfig
config BOARD_ACN52840
	bool "ACN52840 custom board"
	depends on SOC_NRF52840_QIAA
```

## boards/arm/acn52840/Kconfig.defconfig
```kconfig
if BOARD_ACN52840

config BOARD
	default "acn52840"

config BT_CTLR
	default BT

endif #BOARD_ACN52840
```

## boards/arm/acn52840/acn52840_defconfig
```kconfig
# same as boards/arm/nrf52840dk_nrf52840/nrf52840dk_nrf52840_defconfig

CONFIG_SOC_SERIES_NRF52X=y
CONFIG_SOC_NRF52840_QIAA=y
CONFIG_BOARD_ACN52840=y

# Enable MPU
CONFIG_ARM_MPU=y

# Enable hardware stack protection
CONFIG_HW_STACK_PROTECTION=y

# Enable RTT
CONFIG_USE_SEGGER_RTT=y

# enable GPIO
CONFIG_GPIO=y

# enable uart driver
CONFIG_SERIAL=y

# enable console
CONFIG_CONSOLE=y
CONFIG_UART_CONSOLE=y

# additional board options
CONFIG_GPIO_AS_PINRESET=y

CONFIG_UART_CONSOLE=n
CONFIG_RTT_CONSOLE=y
```

## boards/arm/custom_acn52840/Kconfig.board
```kconfig
config BOARD_CUSTOM_ACN52840
	bool "ACN52840 custom board"
	depends on SOC_NRF52840_QIAA
```

## boards/arm/custom_acn52840/Kconfig.defconfig
```kconfig
if BOARD_CUSTOM_ACN52840

config BOARD
	default "custom_acn52840"

config BT_CTLR
	default BT

endif #BOARD_CUSTOM_ACN52840
```

## boards/arm/myBoard1/Kconfig.defconfig
```kconfig
if MY_BOARD_1

config SPI_STM32_INTERRUPT
    default y
    depends on SPI

endif
```

## src/io/Kconfig
```kconfig
# Config for counter alarm sample

config COUNTER_RTC2
	bool
	default y if SOC_FAMILY_NRF

config COUNTER_TIMER3
	bool
	default y if SOC_FAMILY_NRF
```
